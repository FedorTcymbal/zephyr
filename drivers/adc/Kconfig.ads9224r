## drivers/adc/Kconfig.ads9224r
```kconfig
# Copyright (c) 2025 Custom Company
# SPDX-License-Identifier: Apache-2.0

config ADC_ADS9224R
	bool "TI ADS9224R ADC driver"
	default y
	depends on DT_HAS_TI_ADS9224R_ENABLED
	select SPI
	help
	  Enable driver for TI ADS9224R ADC.

if ADC_ADS9224R

config ADC_ADS9224R_ACQUISITION_THREAD_STACK_SIZE
	int "Stack size for the ADC data acquisition thread"
	default 512
	help
	  Size of the stack used for the internal data acquisition
	  thread.

config ADC_ADS9224R_ACQUISITION_THREAD_PRIO
	int "Priority for the ADC data acquisition thread"
	default 0
	help
	  Priority level for the internal ADC data acquisition thread.

endif # ADC_ADS9224R
```

## dts/bindings/adc/ti,ads9224r.yaml
```yaml
# Copyright (c) 2025 Custom Company
# SPDX-License-Identifier: Apache-2.0

description: Texas Instruments ADS9224R ADC

compatible: "ti,ads9224r"

include: spi-device.yaml

properties:
  drdy-gpios:
    type: phandle-array
    description: |
      Data ready pin.
      
      The DRDY pin signals when a conversion is complete and data
      is ready to be read. This signal is active low by default.

  channels:
    type: int
    required: true
    description: Number of input channels available on the device
    enum:
      - 2
      - 4

  reset-gpios:
    type: phandle-array
    description: |
      Reset pin.
      
      Optional external hardware reset pin. If specified, this pin will be
      set active during initialization to reset the device.

  spi-max-frequency:
    required: true
    description: |
      Maximum SPI bus frequency supported by the device.
      Typical maximum frequency is 16 MHz.
```
